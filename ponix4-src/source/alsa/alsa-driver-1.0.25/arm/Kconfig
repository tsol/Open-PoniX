## ponix4-src/source/alsa/alsa-driver-1.0.25/arm/Kconfig
```kconfig
if SND_ARM

config SND_SA11XX_UDA1341
	tristate "SA11xx UDA1341TS driver (iPaq H3600)"
	depends on ARCH_SA1100 && L3
	select SND_PCM
	help
	  Say Y here if you have a Compaq iPaq H3x00 handheld computer
	  and want to use its Philips UDA 1341 audio chip.

	  To compile this driver as a module, choose M here: the module
	  will be called snd-sa11xx-uda1341.

config SND_S3C2410
	tristate "S3C24XX Sound core"
	depends on ARCH_S3C2410
	select I2C_SENSOR
	select SND_PCM
	help
	  Say Y here if you want to use the inbuilt audio controller
	  on the S3C2410 or S3C2440

config SND_PXA2xx_I2SOUND
	tristate
	select SND_PCM

endif	# SND_ARM
```

## ponix4-src/source/alsa/alsa-driver-1.0.25/drivers/Kconfig
```kconfig
# ALSA generic drivers

if SND_DRIVERS

config SND_SERIALMIDI
	tristate "Generic driver for serial MIDI adapters"
	depends on BROKEN
	select SND_RAWMIDI
	help
	  If you want to use MIDI adapters connected to a standard
	  serial port, say Y here and read
	  <file:Documentation/sound/alsa/serialmidi.txt>.

	  For multi-port devices, this driver supports port selection
	  with the Roland SoundCanvas protocol and for Midiator
	  MS-124T/W devices; many other devices are SoundCanvas
	  compatible.

	  To compile this driver as a module, choose M here: the module
	  will be called snd-serialmidi.

config SND_LOOPBACK
	tristate "Generic loopback driver (PCM)"
	select SND_PCM
	help
	  Say 'Y' or 'M' to include support for the PCM loopback device.

endif	# SND_DRIVERS
```

## ponix4-src/source/alsa/alsa-driver-1.0.25/isa/Kconfig
```kconfig
if SND_ISA

config SND_PC98_CS4232
	tristate "NEC PC9800 CS4232 driver"
	depends on X86_PC9800
	select SND_OPL3_LIB
	select SND_MPU401_UART
	select SND_PCM
	help
	  Say Y to include support for the on-board sound chip (CS4232)
	  in NEC PC-9801/PC-8921 PCs.

	  To compile this driver as a module, choose M here: the module
	  will be called snd-pc98-cs4232.

endif	# SND_ISA
```

## ponix4-src/source/alsa/alsa-driver-1.0.25/pci/Kconfig
```kconfig
if SND_PCI

config SND_PDPLUS
	tristate "Sek'D/Marian Prodif Plus"
	select SND_PCM
	help
	  Say Y here to include support for Sek'D/Marian Prodif Plus
	  soundcards.

	  To compile this driver as a module, choose M here: the module
	  will be called snd-pdplus.

endif
```

## ponix4-src/source/compat/backports-3.11-rc3-1/drivers/gpu/drm/cirrus/Kconfig
```kconfig
config DRM_CIRRUS_QEMU
	tristate "Cirrus driver for QEMU emulated device"
	depends on m
	depends on DRM && PCI
	depends on FB_SYS_FILLRECT
	depends on FB_SYS_COPYAREA
	depends on FB_SYS_IMAGEBLIT
	select DRM_KMS_HELPER
	select DRM_TTM
	help
	 This is a KMS driver for emulated cirrus device in qemu.
	 It is *NOT* intended for real cirrus devices. This requires
	 the modesetting userspace X.org driver.
```

## ponix4-src/source/compat/backports-3.11-rc3-1/drivers/gpu/drm/nouveau/Kconfig
```kconfig
config DRM_NOUVEAU
	tristate "Nouveau (nVidia) cards"
	depends on m
	depends on DRM && PCI
        select BACKPORT_FW_LOADER
	select DRM_KMS_HELPER
	select DRM_TTM
	depends on FB_CFB_FILLRECT
	depends on FB_CFB_COPYAREA
	depends on FB_CFB_IMAGEBLIT
	depends on FB
	select FRAMEBUFFER_CONSOLE if !EXPERT
	select FB_BACKLIGHT if DRM_NOUVEAU_BACKLIGHT
	select ACPI_VIDEO if ACPI && X86 && BACKLIGHT_CLASS_DEVICE && VIDEO_OUTPUT_CONTROL && INPUT
	select X86_PLATFORM_DEVICES if ACPI && X86
	select ACPI_WMI if ACPI && X86
	select MXM_WMI if ACPI && X86
	depends on POWER_SUPPLY
	# Similar to i915, we need to select ACPI_VIDEO and it's dependencies
	select BACKLIGHT_LCD_SUPPORT if ACPI && X86
	select BACKLIGHT_CLASS_DEVICE if ACPI && X86
	select VIDEO_OUTPUT_CONTROL if ACPI && X86
	select INPUT if ACPI && X86
	select THERMAL if ACPI && X86
	select ACPI_VIDEO if ACPI && X86
	help
	  Choose this option for open-source nVidia support.

config NOUVEAU_DEBUG
	int "Maximum debug level"
	depends on DRM_NOUVEAU
	range 0 7
	default 5
	help
	  Selects the maximum debug level to compile support for.

	  0 - fatal
	  1 - error
	  2 - warning
	  3 - info
	  4 - debug
	  5 - trace (recommended)
	  6 - paranoia
	  7 - spam

	  The paranoia and spam levels will add a lot of extra checks which
	  may potentially slow down driver operation.

config NOUVEAU_DEBUG_DEFAULT
	int "Default debug level"
	depends on DRM_NOUVEAU
	range 0 7
	default 3
	help
	  Selects the default debug level

config DRM_NOUVEAU_BACKLIGHT
	bool "Support for backlight control"
	depends on DRM_NOUVEAU
	default y
	help
	  Say Y here if you want to control the backlight of your display
	  (e.g. a laptop panel).
```

## ponix4-src/source/compat/backports-3.11-rc3-1/drivers/gpu/drm/omapdrm/Kconfig
```kconfig
config DRM_OMAP
	tristate "OMAP DRM"
	depends on m
	depends on DRM
	depends on ARCH_OMAP2PLUS || ARCH_MULTIPLATFORM
	depends on OMAP2_DSS
	select DRM_KMS_HELPER
	depends on FB_SYS_FILLRECT
	depends on FB_SYS_COPYAREA
	depends on FB_SYS_IMAGEBLIT
	depends on FB_SYS_FOPS
	default n
	help
	  DRM display driver for OMAP2/3/4 based boards.

config DRM_OMAP_NUM_CRTCS
	int "Number of CRTCs"
	range 1 10
	default 1  if ARCH_OMAP2 || ARCH_OMAP3
	default 2  if ARCH_OMAP4
	depends on DRM_OMAP
	help
	  Select the number of video overlays which can be used as framebuffers.
	  The remaining overlays are reserved for video.
```

## ponix4-src/source/compat/backports-3.11-rc3-1/drivers/gpu/drm/qxl/Kconfig
```kconfig
config DRM_QXL
	depends on !BACKPORT_KERNEL_3_3
	tristate "QXL virtual GPU"
	depends on m
	depends on DRM && PCI
	depends on FB_SYS_FILLRECT
	depends on FB_SYS_COPYAREA
	depends on FB_SYS_IMAGEBLIT
	depends on FB_DEFERRED_IO
        select DRM_KMS_HELPER
        select DRM_TTM
	help
		QXL virtual GPU for Spice virtualization desktop integration. Do not enable this driver unless your distro ships a corresponding X.org QXL driver that can handle kernel modesetting.
```

## ponix4-src/source/compat/backports-3.11-rc3-1/drivers/gpu/drm/tilcdc/Kconfig
```kconfig
config DRM_TILCDC
	tristate "DRM Support for TI LCDC Display Controller"
	depends on m
	depends on DRM && OF && ARM
	select DRM_KMS_HELPER
	select DRM_KMS_CMA_HELPER
	select DRM_GEM_CMA_HELPER
	depends on VIDEOMODE_HELPERS
	depends on BACKLIGHT_CLASS_DEVICE
	depends on BACKLIGHT_LCD_SUPPORT
	help
	  Choose this option if you have an TI SoC with LCDC display
	  controller, for example AM33xx in beagle-bone, DA8xx, or
	  OMAP-L1xx.  This driver replaces the FB_DA8XX fbdev driver.
```

## ponix4-src/source/compat/backports-3.11-rc3-1/drivers/gpu/drm/udl/Kconfig
```kconfig
config DRM_UDL
	tristate "DisplayLink"
	depends on m
	depends on DRM
	depends on USB_ARCH_HAS_HCD
	select DRM_USB
	depends on FB_SYS_FILLRECT
	depends on FB_SYS_COPYAREA
	depends on FB_SYS_IMAGEBLIT
	depends on FB_DEFERRED_IO
	select DRM_KMS_HELPER
	help
	  This is a KMS driver for the USB displaylink video adapters.
          Say M/Y to add support for these devices via drm/kms interfaces.
```

## ponix4-src/source/compat/compat-wireless-3.6-rc7-1-snpc/drivers/net/ethernet/atheros/Kconfig
```kconfig
#
# Atheros device configuration
#

config NET_VENDOR_ATHEROS
	bool "Atheros devices"
	default y
	depends on PCI
	---help---
	  If you have a network (Ethernet) card belonging to this class, say Y
	  and read the Ethernet-HOWTO, available from
	  <http://www.tldp.org/docs.html#howto>.

	  Note that the answer to this question doesn't directly affect the
	  kernel: saying N will just cause the configurator to skip all
	  the questions about Atheros devices. If you say Y, you will be asked
	  for your specific card in the following questions.

if NET_VENDOR_ATHEROS

config ATL2
	tristate "Atheros L2 Fast Ethernet support"
	depends on PCI
	select CRC32
	select NET_CORE
	select MII
	---help---
	  This driver supports the Atheros L2 fast ethernet adapter.

	  To compile this driver as a module, choose M here.  The module
	  will be called atl2.

config ATL1
	tristate "Atheros/Attansic L1 Gigabit Ethernet support"
	depends on PCI
	select CRC32
	select NET_CORE
	select MII
	---help---
	  This driver supports the Atheros/Attansic L1 gigabit ethernet
	  adapter.

	  To compile this driver as a module, choose M here.  The module
	  will be called atl1.

config ATL1E
	tristate "Atheros L1E Gigabit Ethernet support (EXPERIMENTAL)"
	depends on PCI && EXPERIMENTAL
	select CRC32
	select NET_CORE
	select MII
	---help---
	  This driver supports the Atheros L1E gigabit ethernet adapter.

	  To compile this driver as a module, choose M here.  The module
	  will be called atl1e.

config ATL1C
	tristate "Atheros L1C Gigabit Ethernet support (DEPRECATED)"
	depends on PCI && EXPERIMENTAL
	select CRC32
	select NET_CORE
	select MII
	---help---
	  This driver supports the Atheros L1C gigabit ethernet adapter.
	  This driver is deprecated in favor for the alx (CONFIG_ALX) driver.
	  This driver supports the following chipsets:

	  1969:1063 - AR8131 Gigabit Ethernet
	  1969:1062 - AR8132 Fast Ethernet (10/100 Mbit/s)
	  1969:2062 - AR8152 v2.0 Fast Ethernet
	  1969:2060 - AR8152 v1.1 Fast Ethernet
	  1969:1073 - AR8151 v1.0 Gigabit Ethernet
	  1969:1083 - AR8151 v2.0 Gigabit Ethernet

	  To compile this driver as a module, choose M here.  The module
	  will be called atl1c.

config ALX
	tristate "Atheros ALX Gigabit Ethernet support"
	depends on PCI
	select CRC32
	select NET_CORE
	select MII
	---help---
	  This driver supports the Atheros L1C/L1D/L1F gigabit ethernet
	  adapter. The alx driver is intended to replace completely the
	  atl1c driver with proper support and commitment from Qualcomm
	  Atheros (QCA). Both atl1c and alx supports the following chipsets:

	  1969:1063 - AR8131 Gigabit Ethernet
	  1969:1062 - AR8132 Fast Ethernet (10/100 Mbit/s)
	  1969:2062 - AR8152 v2.0 Fast Ethernet
	  1969:2060 - AR8152 v1.1 Fast Ethernet
	  1969:1073 - AR8151 v1.0 Gigabit Ethernet
	  1969:1083 - AR8151 v2.0 Gigabit Ethernet

	  Only alx supports the following chipsets:

	  1969:1091 - AR8161
	  1969:1090 - AR8162

	  For more information see:

	  https://www.linuxfoundation.org/collaborate/workgroups/networking/alx

	  To compile this driver as a module, choose M here.  The module
	  will be called alx.

endif # NET_VENDOR_ATHEROS
```

## ponix4-src/source/kernel-3.16.5/linux-3.16.5/fs/Kconfig.rej
```kconfig
--- fs/Kconfig
+++ fs/Kconfig
@@ -220,6 +220,7 @@
 source "fs/sysv/Kconfig"
 source "fs/ufs/Kconfig"
 source "fs/exofs/Kconfig"
+source "fs/aufs/Kconfig"
 
 endif # MISC_FILESYSTEMS
 
```
